#include <dt-bindings/zmk/matrix_transform.h>

/ {
    chosen {
        zmk,matrix-transform = &dongle_transform;
    };

    dongle_transform: matrix_transform {
        compatible = "zmk,matrix-transform";
        rows = <1>;
        columns = <1>;
        map = <RC(0,0)>;
    };
};