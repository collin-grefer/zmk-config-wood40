## boards/shields/wood40/Kconfig.defconfig
```kconfig
if SHIELD_WOOD40_LEFT || SHIELD_WOOD40_RIGHT || SHIELD_WOOD40_DONGLE
    config ZMK_KEYBOARD_NAME
        default "wood40"

    config ZMK_SPLIT
        default y
endif

if SHIELD_WOOD40_RIGHT
    config SPI
        default y
    config INPUT
        default y
    config ZMK_POINTING
        default y
    config ZMK_MOUSE
        default y
endif

if SHIELD_WOOD40_DONGLE
    config ZMK_SPLIT_ROLE_CENTRAL
        default y
endif
```

## boards/shields/wood40/Kconfig.shield
```kconfig
# Copyright (c) 2020 Pete Johanson
# SPDX-License-Identifier: MIT

config SHIELD_WOOD40_LEFT
    def_bool $(shields_list_contains,wood40_left)

config SHIELD_WOOD40_RIGHT
    def_bool $(shields_list_contains,wood40_right)

config SHIELD_WOOD40_DONGLE
    def_bool $(shields_list_contains,wood40_dongle)
```

## config/west.yml
```yaml
manifest:
  defaults:
    revision: v0.3-branch
  remotes:
    - name: zmkfirmware
      url-base: https://github.com/zmkfirmware
    - name: badjeff
      url-base: https://github.com/badjeff
  projects:
    - name: zmk
      remote: zmkfirmware
      import: app/west.yml
    - name: zmk-pmw3610-driver
      remote: badjeff
      revision: zmk-0.3
  self:
    path: config
```
