/ {
    split_inputs {
        #address-cells = <1>;
        #size-cells = <0>;

        trackball_split_input: trackball_split_input@0 {
            compatible = "zmk,input-split";
            reg = <0>;
        };
    };

    trackball_split_listener: trackball_split_listener {
        compatible = "zmk,input-listener";
        status = "disabled";
        device = <&trackball_split_input>;
    };
};