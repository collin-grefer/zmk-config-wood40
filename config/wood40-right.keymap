/*
 * Copyright (c) 2022 The ZMK Contributors
 *
 * SPDX-License-Identifier: MIT
 */

#include <behaviors.dtsi>
#include <dt-bindings/zmk/keys.h>
#include <dt-bindings/zmk/bt.h>

/ {
    keymap {
        compatible = "zmk,keymap";

        default-layer = <0>;

        /* 4 rows × 5 cols (right half) — simplified complement to woody_left */
        layers = <
            /* layer 0 */
            &kp M  &kp N  &kp O  &kp P  &kp ENTER
            &kp G  &kp H  &kp J  &kp K  &kp L
            &kp B  &kp T  &kp Y  &kp U  &kp I
            &kp ESC &kp TAB &kp SPC &kp RSHIFT &kp TRNS
        >;
    };
};