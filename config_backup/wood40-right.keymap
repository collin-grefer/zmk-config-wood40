/*
 * Copyright (c) 2022 The ZMK Contributors
 *
 * SPDX-License-Identifier: MIT
 */

#include <behaviors.dtsi>
#include <dt-bindings/zmk/keys.h>
#include <dt-bindings/zmk/bt.h>

/ {
    chosen {
        zmk,kscan = &kscan0;
    };

    kscan0: kscan {
        compatible = "zmk,kscan-gpio-matrix";
        diode-direction = "col2row";

        row-gpios = <&gpio0 17 (GPIO_ACTIVE_HIGH | GPIO_PULL_DOWN)>,
                    <&gpio0 24 (GPIO_ACTIVE_HIGH | GPIO_PULL_DOWN)>,
                    <&gpio1  0 (GPIO_ACTIVE_HIGH | GPIO_PULL_DOWN)>,
                    <&gpio0 11 (GPIO_ACTIVE_HIGH | GPIO_PULL_DOWN)>;

        col-gpios = <&gpio1  4 GPIO_ACTIVE_HIGH>,
                    <&gpio1  6 GPIO_ACTIVE_HIGH>,
                    <&gpio0 10 GPIO_ACTIVE_HIGH>,
                    <&gpio0  9 GPIO_ACTIVE_HIGH>,
                    <&gpio1  1 GPIO_ACTIVE_HIGH>;
    };
};

/ {
    keymap {
        compatible = "zmk,keymap";

        default-layer = <0>;

        /* 4 rows × 5 cols (right half) — simplified complement to woody_left */
        layers = <
            /* layer 0 */
            &kp M  &kp N  &kp O  &kp P  &kp ENTER
            &kp G  &kp H  &kp J  &kp K  &kp L
            &kp B  &kp T  &kp Y  &kp U  &kp I
            &kp ESC &kp TAB &kp SPC &kp RSHIFT &kp TRNS
        >;
    };
};